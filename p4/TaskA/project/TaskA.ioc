# file: TaskA.ioc
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ADC1.Channel-1\#ChannelRegularConversion=ADC_CHANNEL_1
ADC1.ConversionDataManagement=ADC_CONVERSIONDATA_DMA_ONESHOT
ADC1.ExternalTrigConv=ADC_EXTERNALTRIG_T1_TRGO
ADC1.NbrOfConversionFlag=1
ADC1.OffsetNumber-1\#ChannelRegularConversion=ADC_OFFSET_NONE
ADC1.Rank-1\#ChannelRegularConversion=1
ADC1.SamplingTime-1\#ChannelRegularConversion=ADC_SAMPLETIME_1CYCLE_5
ADC1.master=1
ADC2.Channel-0\#ChannelRegularConversion=ADC_CHANNEL_1
ADC2.NbrOfConversionFlag=1
ADC2.OffsetNumber-0\#ChannelRegularConversion=ADC_OFFSET_NONE
ADC2.Rank-0\#ChannelRegularConversion=1
ADC2.SamplingTime-0\#ChannelRegularConversion=ADC_SAMPLETIME_1CYCLE_5
ADC2.SingleDiff-0\#ChannelRegularConversion=ADC_DIFFERENTIAL_ENDED
ADC3.Channel-0\#ChannelRegularConversion=ADC_CHANNEL_1
ADC3.NbrOfConversionFlag=1
ADC3.OffsetNumber-0\#ChannelRegularConversion=ADC_OFFSET_NONE
ADC3.Rank-0\#ChannelRegularConversion=1
ADC3.SamplingTime-0\#ChannelRegularConversion=ADC_SAMPLETIME_1CYCLE_5
ADC3.SingleDiff-0\#ChannelRegularConversion=ADC_DIFFERENTIAL_ENDED
CORTEX_M7.CPU_DCache=Disabled
CORTEX_M7.CPU_ICache=Enabled
CORTEX_M7.MPU_Control=__NULL
DAC1.DAC_Channel-DAC_OUT1_ExtAndInt=DAC_CHANNEL_1
DAC1.DAC_Channel-DAC_OUT2_ExtAndInt=DAC_CHANNEL_2
DAC1.DAC_Trigger-DAC_OUT1_ExtAndInt=DAC_TRIGGER_T1_TRGO
DAC1.DAC_Trigger-DAC_OUT2_ExtAndInt=DAC_TRIGGER_T1_TRGO
Dma.ADC1.2.Direction=DMA_PERIPH_TO_MEMORY
Dma.ADC1.2.EventEnable=DISABLE
Dma.ADC1.2.FIFOMode=DMA_FIFOMODE_DISABLE
Dma.ADC1.2.Instance=DMA1_Stream4
Dma.ADC1.2.MemDataAlignment=DMA_MDATAALIGN_WORD
Dma.ADC1.2.MemInc=DMA_MINC_ENABLE
Dma.ADC1.2.Mode=DMA_NORMAL
Dma.ADC1.2.PeriphDataAlignment=DMA_PDATAALIGN_WORD
Dma.ADC1.2.PeriphInc=DMA_PINC_DISABLE
Dma.ADC1.2.Polarity=HAL_DMAMUX_REQ_GEN_RISING
Dma.ADC1.2.Priority=DMA_PRIORITY_LOW
Dma.ADC1.2.RequestNumber=1
Dma.ADC1.2.SignalID=NONE
Dma.ADC1.2.SyncEnable=DISABLE
Dma.ADC1.2.SyncPolarity=HAL_DMAMUX_SYNC_NO_EVENT
Dma.ADC1.2.SyncRequestNumber=1
Dma.ADC1.2.SyncSignalID=NONE
Dma.DAC1_CH1.0.Direction=DMA_MEMORY_TO_PERIPH
Dma.DAC1_CH1.0.EventEnable=DISABLE
Dma.DAC1_CH1.0.FIFOMode=DMA_FIFOMODE_DISABLE
Dma.DAC1_CH1.0.Instance=DMA1_Stream2
Dma.DAC1_CH1.0.MemDataAlignment=DMA_MDATAALIGN_WORD
Dma.DAC1_CH1.0.MemInc=DMA_MINC_ENABLE
Dma.DAC1_CH1.0.Mode=DMA_NORMAL
Dma.DAC1_CH1.0.PeriphDataAlignment=DMA_PDATAALIGN_WORD
Dma.DAC1_CH1.0.PeriphInc=DMA_PINC_DISABLE
Dma.DAC1_CH1.0.Polarity=HAL_DMAMUX_REQ_GEN_RISING
Dma.DAC1_CH1.0.Priority=DMA_PRIORITY_LOW
Dma.DAC1_CH1.0.RequestNumber=1
Dma.DAC1_CH1.0.SignalID=NONE
Dma.DAC1_CH1.0.SyncEnable=DISABLE
Dma.DAC1_CH1.0.SyncPolarity=HAL_DMAMUX_SYNC_NO_EVENT
Dma.DAC1_CH1.0.SyncRequestNumber=1
Dma.DAC1_CH1.0.SyncSignalID=NONE
Dma.DAC1_CH2.1.Direction=DMA_MEMORY_TO_PERIPH
Dma.DAC1_CH2.1.EventEnable=DISABLE
Dma.DAC1_CH2.1.FIFOMode=DMA_FIFOMODE_DISABLE
Dma.DAC1_CH2.1.Instance=DMA1_Stream3
Dma.DAC1_CH2.1.MemDataAlignment=DMA_MDATAALIGN_WORD
Dma.DAC1_CH2.1.MemInc=DMA_MINC_ENABLE
Dma.DAC1_CH2.1.Mode=DMA_NORMAL
Dma.DAC1_CH2.1.PeriphDataAlignment=DMA_PDATAALIGN_WORD
Dma.DAC1_CH2.1.PeriphInc=DMA_PINC_DISABLE
Dma.DAC1_CH2.1.Polarity=HAL_DMAMUX_REQ_GEN_RISING
Dma.DAC1_CH2.1.Priority=DMA_PRIORITY_LOW
Dma.DAC1_CH2.1.RequestNumber=1
Dma.DAC1_CH2.1.SignalID=NONE
Dma.DAC1_CH2.1.SyncEnable=DISABLE
Dma.DAC1_CH2.1.SyncPolarity=HAL_DMAMUX_SYNC_NO_EVENT
Dma.DAC1_CH2.1.SyncRequestNumber=1
Dma.DAC1_CH2.1.SyncSignalID=NONE
Dma.I2C2_RX.3.Direction=DMA_PERIPH_TO_MEMORY
Dma.I2C2_RX.3.EventEnable=DISABLE
Dma.I2C2_RX.3.FIFOMode=DMA_FIFOMODE_DISABLE
Dma.I2C2_RX.3.Instance=DMA1_Stream0
Dma.I2C2_RX.3.MemDataAlignment=DMA_MDATAALIGN_BYTE
Dma.I2C2_RX.3.MemInc=DMA_MINC_ENABLE
Dma.I2C2_RX.3.Mode=DMA_NORMAL
Dma.I2C2_RX.3.PeriphDataAlignment=DMA_PDATAALIGN_BYTE
Dma.I2C2_RX.3.PeriphInc=DMA_PINC_DISABLE
Dma.I2C2_RX.3.Polarity=HAL_DMAMUX_REQ_GEN_RISING
Dma.I2C2_RX.3.Priority=DMA_PRIORITY_LOW
Dma.I2C2_RX.3.RequestNumber=1
Dma.I2C2_RX.3.SignalID=NONE
Dma.I2C2_RX.3.SyncEnable=DISABLE
Dma.I2C2_RX.3.SyncPolarity=HAL_DMAMUX_SYNC_NO_EVENT
Dma.I2C2_RX.3.SyncRequestNumber=1
Dma.I2C2_RX.3.SyncSignalID=NONE
Dma.I2C2_TX.4.Direction=DMA_MEMORY_TO_PERIPH
Dma.I2C2_TX.4.EventEnable=DISABLE
Dma.I2C2_TX.4.FIFOMode=DMA_FIFOMODE_DISABLE
Dma.I2C2_TX.4.Instance=DMA1_Stream1
Dma.I2C2_TX.4.MemDataAlignment=DMA_MDATAALIGN_BYTE
Dma.I2C2_TX.4.MemInc=DMA_MINC_ENABLE
Dma.I2C2_TX.4.Mode=DMA_NORMAL
Dma.I2C2_TX.4.PeriphDataAlignment=DMA_PDATAALIGN_BYTE
Dma.I2C2_TX.4.PeriphInc=DMA_PINC_DISABLE
Dma.I2C2_TX.4.Polarity=HAL_DMAMUX_REQ_GEN_RISING
Dma.I2C2_TX.4.Priority=DMA_PRIORITY_LOW
Dma.I2C2_TX.4.RequestNumber=1
Dma.I2C2_TX.4.SignalID=NONE
Dma.I2C2_TX.4.SyncEnable=DISABLE
Dma.I2C2_TX.4.SyncPolarity=HAL_DMAMUX_SYNC_NO_EVENT
Dma.I2C2_TX.4.SyncRequestNumber=1
Dma.I2C2_TX.4.SyncSignalID=NONE
Dma.Request0=DAC1_CH1
Dma.Request1=DAC1_CH2
Dma.Request2=ADC1
Dma.Request3=I2C2_RX
Dma.Request4=I2C2_TX
I2C2.Timing=0x00909FCE
I2C3.Timing=0x00909FCE
I2C4.Timing=0x00909FCE
Mcu.Family=STM32H7
Mcu.Name=STM32H743XIHx
Mcu.Package=TFBGA240
NVIC.ADC_IRQn=true\:0\:0\:false\:false\:true\:true\:true\:true
NVIC.DMA1_Stream0_IRQn=true\:0\:0\:false\:false\:true\:false\:true\:true
NVIC.DMA1_Stream1_IRQn=true\:0\:0\:false\:false\:true\:false\:true\:true
NVIC.DMA1_Stream2_IRQn=true\:0\:0\:false\:false\:true\:false\:true\:true
NVIC.DMA1_Stream3_IRQn=true\:0\:0\:false\:false\:true\:false\:true\:true
NVIC.DMA1_Stream4_IRQn=true\:0\:0\:false\:false\:true\:false\:true\:true
NVIC.EXTI15_10_IRQn=true\:0\:0\:false\:false\:true\:true\:true\:true
NVIC.I2C2_ER_IRQn=true\:2\:0\:true\:false\:true\:true\:true\:true
NVIC.I2C2_EV_IRQn=true\:2\:0\:true\:false\:true\:true\:true\:true
NVIC.PriorityGroup=NVIC_PRIORITYGROUP_4
NVIC.TIM1_UP_IRQn=true\:0\:0\:false\:false\:true\:true\:true\:true
NVIC.TIM2_IRQn=true\:0\:0\:false\:false\:true\:true\:true\:true
PA0_C.Signal=ADCx_INN1
PA10.Mode=OTG/Dual_Role_Device
PA10.Signal=USB_OTG_FS_ID
PA11.Mode=OTG/Dual_Role_Device
PA11.Signal=USB_OTG_FS_DM
PA12.Mode=OTG/Dual_Role_Device
PA12.Signal=USB_OTG_FS_DP
PA13\ (JTMS/SWDIO).Mode=JTAG_5_pins
PA13\ (JTMS/SWDIO).Signal=DEBUG_JTMS-SWDIO
PA14\ (JTCK/SWCLK).Mode=JTAG_5_pins
PA14\ (JTCK/SWCLK).Signal=DEBUG_JTCK-SWCLK
PA15\ (JTDI).Mode=JTAG_5_pins
PA15\ (JTDI).Signal=DEBUG_JTDI
PA1_C.Signal=ADCx_INP1
PA4.Signal=COMP_DAC11_group
PA5.Signal=COMP_DAC12_group
PA6.Signal=S_TIM3_CH1
PA8.Mode=Synchronous
PA8.Signal=USART1_CK
PA9.Mode=Asynchronous
PA9.Signal=LPUART1_TX
PB0.Signal=ADCx_INN5
PB1.Signal=ADCx_INP5
PB14.Mode=Synchronous
PB14.Signal=USART1_TX
PB15.Mode=Synchronous
PB15.Signal=USART1_RX
PB3\ (JTDO/TRACESWO).Mode=JTAG_5_pins
PB3\ (JTDO/TRACESWO).Signal=DEBUG_JTDO-SWO
PB4\ (NJTRST).Mode=JTAG_5_pins
PB4\ (NJTRST).Signal=DEBUG_JTRST
PB6.GPIO_Pu=GPIO_PULLUP
PB6.Mode=I2C
PB6.Signal=I2C4_SCL
PB7.Mode=Asynchronous
PB7.Signal=LPUART1_RX
PB8.Signal=S_TIM4_CH3
PB9.Mode=Asynchronous
PB9.Signal=UART4_TX
PC0.Signal=FMC_SDNWE
PC13.GPIO_Label=CDET
PC13.GPIO_PuPd=GPIO_PULLUP
PC13.Signal=GPIO_Input
PC14-OSC32_IN\ (OSC32_IN).Mode=LSE-External-Oscillator
PC14-OSC32_IN\ (OSC32_IN).Signal=RCC_OSC32_IN
PC15-OSC32_OUT\ (OSC32_OUT).Mode=LSE-External-Oscillator
PC15-OSC32_OUT\ (OSC32_OUT).Signal=RCC_OSC32_OUT
PC2.Signal=ADCx_INP12
PC2_C.Mode=IN1-Differential
PC2_C.Signal=ADC3_INN1
PC3.Signal=ADCx_INN12
PC3_C.Mode=IN1-Differential
PC3_C.Signal=ADC3_INP1
PC6.Mode=Output_TA1TA2
PC6.Signal=HRTIM_CHA1
PC7.Mode=Output_TA1TA2
PC7.Signal=HRTIM_CHA2
PD0.Signal=FMC_D2_DA2
PD1.Signal=FMC_D3_DA3
PD10.Signal=FMC_D15_DA15
PD11.Signal=GPIO_Output
PD12.Signal=S_TIM4_CH1
PD13.Signal=S_TIM4_CH2
PD14.Signal=FMC_D0_DA0
PD15.Signal=FMC_D1_DA1
PD3.Signal=GPIO_Output
PD4.Mode=Fault_Enable3
PD4.Signal=HRTIM_FLT3
PD5.Mode=Asynchronous
PD5.Signal=USART2_TX
PD6.Mode=Asynchronous
PD6.Signal=USART2_RX
PD7.Mode=Full_Duplex_Master
PD7.Signal=SPI1_MOSI
PD8.Signal=FMC_D13_DA13
PD9.Signal=FMC_D14_DA14
PE0.Mode=Asynchronous
PE0.Signal=UART8_RX
PE1.Mode=SCOUTmode
PE1.Signal=HRTIM_SCOUT
PE10.Signal=FMC_D7_DA7
PE11.Signal=FMC_D8_DA8
PE12.Signal=FMC_D9_DA9
PE13.Signal=FMC_D10_DA10
PE14.Signal=FMC_D11_DA11
PE15.Signal=FMC_D12_DA12
PE2.Signal=GPIO_Output
PE6.Signal=S_TIM15_CH2
PE7.Signal=FMC_D4_DA4
PE8.Signal=FMC_D5_DA5
PE9.Signal=FMC_D6_DA6
PF0.Signal=FMC_A0
PF1.Signal=FMC_A1
PF10.Mode=IN6-Single-Ended
PF10.Signal=ADC3_INP6
PF11.Signal=FMC_SDNRAS
PF12.Signal=FMC_A6
PF13.Signal=FMC_A7
PF14.Signal=FMC_A8
PF15.Signal=FMC_A9
PF2.Signal=FMC_A2
PF3.Signal=FMC_A3
PF4.Signal=FMC_A4
PF5.Signal=FMC_A5
PF6.Mode=Asynchronous
PF6.Signal=UART7_RX
PF7.Mode=Asynchronous
PF7.Signal=UART7_TX
PF8.Mode=Full_Duplex_Master
PF8.Signal=SPI5_MISO
PF9.Signal=S_TIM14_CH1
PG0.Signal=FMC_A10
PG1.Signal=FMC_A11
PG10.Mode=NSS_Signal_Hard_Output
PG10.Signal=SPI1_NSS
PG11.Mode=Full_Duplex_Master
PG11.Signal=SPI1_SCK
PG12.Mode=Full_Duplex_Master
PG12.Signal=SPI6_MISO
PG13.Mode=Full_Duplex_Master
PG13.Signal=SPI6_SCK
PG14.Mode=Full_Duplex_Master
PG14.Signal=SPI6_MOSI
PG15.Signal=FMC_SDNCAS
PG2.Signal=FMC_A12
PG3.Signal=GPIO_Output
PG4.Signal=FMC_A14_BA0
PG5.Signal=FMC_A15_BA1
PG6.Mode=Output_TE1TE2
PG6.Signal=HRTIM_CHE1
PG7.Mode=Output_TE1TE2
PG7.Signal=HRTIM_CHE2
PG8.Signal=FMC_SDCLK
PG9.Mode=Full_Duplex_Master
PG9.Signal=SPI1_MISO
PH0-OSC_IN\ (PH0).Mode=HSE-External-Oscillator
PH0-OSC_IN\ (PH0).Signal=RCC_OSC_IN
PH1-OSC_OUT\ (PH1).Mode=HSE-External-Oscillator
PH1-OSC_OUT\ (PH1).Signal=RCC_OSC_OUT
PH10.Signal=S_TIM5_CH1
PH11.Signal=S_TIM5_CH2
PH12.GPIO_Pu=GPIO_PULLUP
PH12.Mode=I2C
PH12.Signal=I2C4_SDA
PH14.Mode=Asynchronous
PH14.Signal=UART4_RX
PH15.Signal=GPIO_Output
PH2.Mode=SdramChipSelect1_1
PH2.Signal=FMC_SDCKE0
PH3.Mode=SdramChipSelect1_1
PH3.Signal=FMC_SDNE0
PH4.GPIO_Pu=GPIO_PULLUP
PH4.Mode=I2C
PH4.Signal=I2C2_SCL
PH5.GPIO_Pu=GPIO_PULLUP
PH5.Mode=I2C
PH5.Signal=I2C2_SDA
PH6.Signal=S_TIM12_CH1
PH7.GPIO_Pu=GPIO_PULLUP
PH7.Mode=I2C
PH7.Signal=I2C3_SCL
PH8.GPIO_Pu=GPIO_PULLUP
PH8.Mode=I2C
PH8.Signal=I2C3_SDA
PI0.Mode=NSS_Signal_Hard_Output
PI0.Signal=SPI2_NSS
PI1.Mode=Full_Duplex_Master
PI1.Signal=SPI2_SCK
PI10.Signal=GPIO_Output
PI11.Signal=GPXTI11
PI12.Signal=GPIO_Output
PI13.Signal=GPIO_Output
PI14.Signal=GPIO_Output
PI15.Signal=GPIO_Output
PI2.Mode=Full_Duplex_Master
PI2.Signal=SPI2_MISO
PI3.Mode=Full_Duplex_Master
PI3.Signal=SPI2_MOSI
PI4.Signal=GPIO_Output
PI5.Signal=S_TIM8_CH1
PI6.Signal=S_TIM8_CH2
PI7.Signal=GPIO_Output
PI8.Signal=GPIO_Output
PJ0.GPIO_Label=SEGA
PJ0.Signal=GPIO_Output
PJ1.GPIO_Label=SEGB
PJ1.Signal=GPIO_Output
PJ10.Mode=Full_Duplex_Master
PJ10.Signal=SPI5_MOSI
PJ12.GPIO_Label=BTN1
PJ12.GPIO_ModeDefaultEXTI=GPIO_MODE_IT_RISING
PJ12.Signal=GPXTI12
PJ13.GPIO_Label=BTN2
PJ13.Signal=GPXTI13
PJ14.Signal=GPIO_Output
PJ15.Signal=GPXTI15
PJ2.GPIO_Label=SEGC
PJ2.Signal=GPIO_Output
PJ3.GPIO_Label=SEGD
PJ3.Signal=GPIO_Output
PJ4.GPIO_Label=SEGE
PJ4.Signal=GPIO_Output
PJ5.GPIO_Label=SEGF
PJ5.Signal=GPIO_Output
PJ6.GPIO_Label=SEGG
PJ6.Signal=GPIO_Output
PJ7.GPIO_Label=SEGDP
PJ7.Signal=GPIO_Output
PJ8.Mode=Asynchronous
PJ8.Signal=UART8_TX
PK0.Mode=Full_Duplex_Master
PK0.Signal=SPI5_SCK
PK2.Signal=GPIO_Output
PK3.Signal=GPIO_Output
PK4.Signal=GPIO_Output
PK5.Signal=GPIO_Output
PK6.Signal=GPIO_Output
PK7.Signal=GPIO_Output
ProjectManager.HeapSize=0x200
ProjectManager.StackSize=0x400
ProjectManager.TargetToolchain=Makefile
RCC.ADCFreq_Value=37500000
RCC.APB1Freq_Value=37500000
RCC.APB2Freq_Value=37500000
RCC.APB3Freq_Value=37500000
RCC.APB4Freq_Value=37500000
RCC.CortexFreq_Value=75000000
RCC.D1PPRE=RCC_APB3_DIV2
RCC.D2PPRE1=RCC_APB1_DIV2
RCC.D2PPRE2=RCC_APB2_DIV2
RCC.D3PPRE=RCC_APB4_DIV2
RCC.DIVM1=1
RCC.DIVM2=1
RCC.DIVN1=9
RCC.DIVN2=9
RCC.DIVP2=4
RCC.HCLKFreq_Value=75000000
RCC.HSE_VALUE=16000000
RCC.PLL2FRACN=3072
RCC.PLLFRACN=3072
RCC.PLLSourceVirtual=RCC_PLLSOURCE_HSE
RCC.SYSCLKFreq_VALUE=75000000
RCC.SYSCLKSource=RCC_SYSCLKSOURCE_PLLCLK
RCC.USBCLockSelection=RCC_USBCLKSOURCE_HSI48
RCC.USBFreq_Value=48000000
SH.ADCx_INN1.0=ADC2_INN1,IN1-Differential
SH.ADCx_INN1.1=ADC1_INN1
SH.ADCx_INN12.0=ADC1_INN12,IN12-Differential
SH.ADCx_INN12.1=ADC2_INN12,IN12-Differential
SH.ADCx_INN5.0=ADC2_INN5,IN5-Differential
SH.ADCx_INN5.1=ADC1_INN5,IN5-Differential
SH.ADCx_INP1.0=ADC2_INP1,IN1-Differential
SH.ADCx_INP1.1=ADC1_INP1,IN1-Single-Ended
SH.ADCx_INP12.0=ADC1_INP12,IN12-Differential
SH.ADCx_INP12.1=ADC2_INP12,IN12-Differential
SH.ADCx_INP12.2=ADC3_INP12,IN12-Single-Ended
SH.ADCx_INP5.0=ADC2_INP5,IN5-Differential
SH.ADCx_INP5.1=ADC1_INP5,IN5-Differential
SH.COMP_DAC11_group.0=DAC1_OUT1,DAC_OUT1_ExtAndInt
SH.COMP_DAC12_group.0=DAC1_OUT2,DAC_OUT2_ExtAndInt
SH.FMC_A0.0=FMC_A0,13b-sda1
SH.FMC_A1.0=FMC_A1,13b-sda1
SH.FMC_A10.0=FMC_A10,13b-sda1
SH.FMC_A11.0=FMC_A11,13b-sda1
SH.FMC_A12.0=FMC_A12,13b-sda1
SH.FMC_A14_BA0.0=FMC_BA0,FourSdramBanks1
SH.FMC_A15_BA1.0=FMC_BA1,FourSdramBanks1
SH.FMC_A2.0=FMC_A2,13b-sda1
SH.FMC_A3.0=FMC_A3,13b-sda1
SH.FMC_A4.0=FMC_A4,13b-sda1
SH.FMC_A5.0=FMC_A5,13b-sda1
SH.FMC_A6.0=FMC_A6,13b-sda1
SH.FMC_A7.0=FMC_A7,13b-sda1
SH.FMC_A8.0=FMC_A8,13b-sda1
SH.FMC_A9.0=FMC_A9,13b-sda1
SH.FMC_D0_DA0.0=FMC_D0,sd-16b-d1
SH.FMC_D10_DA10.0=FMC_D10,sd-16b-d1
SH.FMC_D11_DA11.0=FMC_D11,sd-16b-d1
SH.FMC_D12_DA12.0=FMC_D12,sd-16b-d1
SH.FMC_D13_DA13.0=FMC_D13,sd-16b-d1
SH.FMC_D14_DA14.0=FMC_D14,sd-16b-d1
SH.FMC_D15_DA15.0=FMC_D15,sd-16b-d1
SH.FMC_D1_DA1.0=FMC_D1,sd-16b-d1
SH.FMC_D2_DA2.0=FMC_D2,sd-16b-d1
SH.FMC_D3_DA3.0=FMC_D3,sd-16b-d1
SH.FMC_D4_DA4.0=FMC_D4,sd-16b-d1
SH.FMC_D5_DA5.0=FMC_D5,sd-16b-d1
SH.FMC_D6_DA6.0=FMC_D6,sd-16b-d1
SH.FMC_D7_DA7.0=FMC_D7,sd-16b-d1
SH.FMC_D8_DA8.0=FMC_D8,sd-16b-d1
SH.FMC_D9_DA9.0=FMC_D9,sd-16b-d1
SH.FMC_SDCLK.0=FMC_SDCLK,13b-sda1
SH.FMC_SDNCAS.0=FMC_SDNCAS,13b-sda1
SH.FMC_SDNRAS.0=FMC_SDNRAS,13b-sda1
SH.FMC_SDNWE.0=FMC_SDNWE,13b-sda1
SH.S_TIM12_CH1.0=TIM12_CH1,PWM_Input_1
SH.S_TIM14_CH1.0=TIM14_CH1,PWM Generation1 CH1
SH.S_TIM15_CH2.0=TIM15_CH2,Input_Capture2_from_TI2
SH.S_TIM3_CH1.0=TIM3_CH1,PWM Generation1 CH1
SH.S_TIM4_CH1.0=TIM4_CH1,Encoder_Interface
SH.S_TIM4_CH2.0=TIM4_CH2,Encoder_Interface
SH.S_TIM4_CH3.0=TIM4_CH3,Input_Capture3_from_TI3
SH.S_TIM5_CH1.0=TIM5_CH1,Encoder_Interface
SH.S_TIM5_CH2.0=TIM5_CH2,Encoder_Interface
SH.S_TIM8_CH1.0=TIM8_CH1,Encoder_Interface
SH.S_TIM8_CH2.0=TIM8_CH2,Encoder_Interface
SPI1.BaudRatePrescaler=SPI_BAUDRATEPRESCALER_32
SPI1.CalculateBaudRate=2.34375 MBits/s
SPI1.Direction=SPI_DIRECTION_2LINES
SPI1.Mode=SPI_MODE_MASTER
SPI1.VirtualNSS=VM_NSSHARD
SPI1.VirtualType=VM_MASTER
SPI2.BaudRatePrescaler=SPI_BAUDRATEPRESCALER_32
SPI2.CalculateBaudRate=2.34375 MBits/s
SPI2.Direction=SPI_DIRECTION_2LINES
SPI2.Mode=SPI_MODE_MASTER
SPI2.VirtualNSS=VM_NSSHARD
SPI2.VirtualType=VM_MASTER
SPI5.CalculateBaudRate=18.75 MBits/s
SPI5.Direction=SPI_DIRECTION_2LINES
SPI5.Mode=SPI_MODE_MASTER
SPI5.VirtualType=VM_MASTER
SPI6.CalculateBaudRate=18.75 MBits/s
SPI6.Direction=SPI_DIRECTION_2LINES
SPI6.Mode=SPI_MODE_MASTER
SPI6.VirtualType=VM_MASTER
TIM1.Period=10-1
TIM1.Prescaler=600-1
TIM1.TIM_MasterOutputTrigger=TIM_TRGO_UPDATE
TIM14.Channel=TIM_CHANNEL_1
TIM15.Channel-Input_Capture2_from_TI2=TIM_CHANNEL_2
TIM2.AutoReloadPreload=TIM_AUTORELOAD_PRELOAD_ENABLE
TIM2.Period=100000
TIM2.Prescaler=75
TIM3.Channel-PWM\ Generation1\ CH1=TIM_CHANNEL_1
TIM4.Channel-Input_Capture3_from_TI3=TIM_CHANNEL_3
TIM4.EncoderMode=TIM_ENCODERMODE_TI1
UART4.BaudRate=115200
USART1.VirtualMode-Synchronous=VM_SYNC
USART2.VirtualMode-Asynchronous=VM_ASYNC
VP_ADC3_TempSens_Input.Mode=IN-TempSens
VP_ADC3_Vbat_Input.Mode=IN-Vbat
VP_ADC3_Vref_Input.Mode=IN-Vrefint
VP_RTC_VS_RTC_Activate.Mode=RTC_Enabled
VP_TIM13_VS_ClockSourceINT.Mode=Enable_Timer
VP_TIM14_VS_ClockSourceINT.Mode=Enable_Timer
VP_TIM16_VS_ClockSourceINT.Mode=Enable_Timer
VP_TIM17_VS_ClockSourceINT.Mode=Enable_Timer
VP_TIM1_VS_ClockSourceINT.Mode=Internal
VP_TIM2_VS_ClockSourceINT.Mode=Internal
VP_TIM6_VS_ClockSourceINT.Mode=Enable_Timer
VP_TIM7_VS_ClockSourceINT.Mode=Enable_Timer
board=custom

// file: Src/main.c
/* USER CODE BEGIN Header */
/**
 ******************************************************************************
 * @file           : main.c
 * @brief          : Main program body
 ******************************************************************************
 * @attention
 *
 * Copyright (c) 2024 STMicroelectronics.
 * All rights reserved.
 *
 * This software is licensed under terms that can be found in the LICENSE file
 * in the root directory of this software component.
 * If no LICENSE file comes with this software, it is provided AS-IS.
 *
 ******************************************************************************
 */
/* USER CODE END Header */
#include "main.h"
#include "adc.h"
#include "dac.h"
#include "dma.h"
#include "hrtim.h"
#include "i2c.h"
#include "usart.h"
#include "rtc.h"
#include "spi.h"
#include "tim.h"
#include "usb_otg.h"
#include "gpio.h"
#include "fmc.h"

/* USER CODE BEGIN PD */

#define MIN_STEP_MS 100
#define MAX_STEP_MS 1000
#define STEPSIZE_MS 100

/* USER CODE END PD */

/* USER CODE BEGIN PM */

// PS 75, f_tim = 75 MHz -> 1000 ms ^= 1000000 steps
#define MS_TO_COUNTERPERIOD(x) ((x) * 1000)

/* USER CODE END PM */

void SystemClock_Config(void);
void PeriphCommonClock_Config(void);

/* USER CODE BEGIN 0 */

void HAL_GPIO_EXTI_Callback(uint16_t GPIO_Pin)
{
  // use local static variable to preserve the current step_ms value
  static uint16_t step_ms = MIN_STEP_MS;

  switch (GPIO_Pin)
  {
  case BTN1_Pin: // increase the step_ms value
    step_ms += STEPSIZE_MS;
    if (step_ms > MAX_STEP_MS)
      step_ms = MAX_STEP_MS;
    break;

  case BTN2_Pin: // decrease the step_ms value
    step_ms -= STEPSIZE_MS;
    if (step_ms < MIN_STEP_MS)
      step_ms = MIN_STEP_MS;
    break;

  default:
    break;
  }

  // update the TIM2 ARR register with the new step_ms value
  TIM2->ARR = MS_TO_COUNTERPERIOD(step_ms);
}

void HAL_TIM_PeriodElapsedCallback(TIM_HandleTypeDef *htim)
{
  if (htim->Instance == TIM2)
  {
    HAL_GPIO_TogglePin(SEGDP_GPIO_Port, SEGDP_Pin);
  }
}

/* USER CODE END 0 */

int main(void)
{
  /* Enable the CPU Cache */

  /* Enable I-Cache---------------------------------------------------------*/
  SCB_EnableICache();

  /* MCU Configuration--------------------------------------------------------*/

  /* Reset of all peripherals, Initializes the Flash interface and the Systick. */
  HAL_Init();

  /* Configure the system clock */
  SystemClock_Config();

  /* Configure the peripherals common clocks */
  PeriphCommonClock_Config();

  /* Initialize all configured peripherals */
  MX_GPIO_Init();
  MX_DMA_Init();
  MX_ADC1_Init();
  MX_ADC2_Init();
  MX_ADC3_Init();
  MX_DAC1_Init();
  MX_FMC_Init();
  MX_HRTIM_Init();
  MX_I2C2_Init();
  MX_I2C3_Init();
  MX_I2C4_Init();
  MX_LPUART1_UART_Init();
  MX_UART4_Init();
  MX_UART7_Init();
  MX_UART8_Init();
  MX_USART1_Init();
  MX_USART2_UART_Init();
  MX_RTC_Init();
  MX_SPI1_Init();
  MX_SPI2_Init();
  MX_SPI5_Init();
  MX_SPI6_Init();
  MX_TIM1_Init();
  MX_TIM2_Init();
  MX_TIM3_Init();
  MX_TIM4_Init();
  MX_TIM5_Init();
  MX_TIM6_Init();
  MX_TIM7_Init();
  MX_TIM8_Init();
  MX_TIM12_Init();
  MX_TIM13_Init();
  MX_TIM14_Init();
  MX_TIM15_Init();
  MX_TIM16_Init();
  MX_TIM17_Init();
  MX_USB_OTG_FS_USB_Init();
  /* USER CODE BEGIN 2 */

  HAL_TIM_Base_Start_IT(&htim2);

  /* USER CODE END 2 */

  /* Infinite loop */
  while (1)
  {

  }
}

void SystemClock_Config(void)
{
  RCC_OscInitTypeDef RCC_OscInitStruct = {0};
  RCC_ClkInitTypeDef RCC_ClkInitStruct = {0};

  /** Supply configuration update enable
   */
  HAL_PWREx_ConfigSupply(PWR_LDO_SUPPLY);

  /** Configure the main internal regulator output voltage
   */
  __HAL_PWR_VOLTAGESCALING_CONFIG(PWR_REGULATOR_VOLTAGE_SCALE3);

  while (!__HAL_PWR_GET_FLAG(PWR_FLAG_VOSRDY))
  {
  }

  /** Initializes the RCC Oscillators according to the specified parameters
   * in the RCC_OscInitTypeDef structure.
   */
  RCC_OscInitStruct.OscillatorType = RCC_OSCILLATORTYPE_HSI48 | RCC_OSCILLATORTYPE_LSI | RCC_OSCILLATORTYPE_HSE;
  RCC_OscInitStruct.HSEState = RCC_HSE_ON;
  RCC_OscInitStruct.LSIState = RCC_LSI_ON;
  RCC_OscInitStruct.HSI48State = RCC_HSI48_ON;
  RCC_OscInitStruct.PLL.PLLState = RCC_PLL_ON;
  RCC_OscInitStruct.PLL.PLLSource = RCC_PLLSOURCE_HSE;
  RCC_OscInitStruct.PLL.PLLM = 1;
  RCC_OscInitStruct.PLL.PLLN = 9;
  RCC_OscInitStruct.PLL.PLLP = 2;
  RCC_OscInitStruct.PLL.PLLQ = 2;
  RCC_OscInitStruct.PLL.PLLR = 2;
  RCC_OscInitStruct.PLL.PLLRGE = RCC_PLL1VCIRANGE_3;
  RCC_OscInitStruct.PLL.PLLVCOSEL = RCC_PLL1VCOMEDIUM;
  RCC_OscInitStruct.PLL.PLLFRACN = 3072;
  if (HAL_RCC_OscConfig(&RCC_OscInitStruct) != HAL_OK)
  {
    Error_Handler();
  }

  /** Initializes the CPU, AHB and APB buses clocks
   */
  RCC_ClkInitStruct.ClockType = RCC_CLOCKTYPE_HCLK | RCC_CLOCKTYPE_SYSCLK | RCC_CLOCKTYPE_PCLK1 | RCC_CLOCKTYPE_PCLK2 | RCC_CLOCKTYPE_D3PCLK1 | RCC_CLOCKTYPE_D1PCLK1;
  RCC_ClkInitStruct.SYSCLKSource = RCC_SYSCLKSOURCE_PLLCLK;
  RCC_ClkInitStruct.SYSCLKDivider = RCC_SYSCLK_DIV1;
  RCC_ClkInitStruct.AHBCLKDivider = RCC_HCLK_DIV1;
  RCC_ClkInitStruct.APB3CLKDivider = RCC_APB3_DIV2;
  RCC_ClkInitStruct.APB1CLKDivider = RCC_APB1_DIV2;
  RCC_ClkInitStruct.APB2CLKDivider = RCC_APB2_DIV2;
  RCC_ClkInitStruct.APB4CLKDivider = RCC_APB4_DIV2;

  if (HAL_RCC_ClockConfig(&RCC_ClkInitStruct, FLASH_LATENCY_1) != HAL_OK)
  {
    Error_Handler();
  }
}

void PeriphCommonClock_Config(void)
{
  RCC_PeriphCLKInitTypeDef PeriphClkInitStruct = {0};

  /** Initializes the peripherals clock
   */
  PeriphClkInitStruct.PeriphClockSelection = RCC_PERIPHCLK_ADC;
  PeriphClkInitStruct.PLL2.PLL2M = 1;
  PeriphClkInitStruct.PLL2.PLL2N = 9;
  PeriphClkInitStruct.PLL2.PLL2P = 4;
  PeriphClkInitStruct.PLL2.PLL2Q = 2;
  PeriphClkInitStruct.PLL2.PLL2R = 2;
  PeriphClkInitStruct.PLL2.PLL2RGE = RCC_PLL2VCIRANGE_3;
  PeriphClkInitStruct.PLL2.PLL2VCOSEL = RCC_PLL2VCOMEDIUM;
  PeriphClkInitStruct.PLL2.PLL2FRACN = 3072;
  PeriphClkInitStruct.AdcClockSelection = RCC_ADCCLKSOURCE_PLL2;
  if (HAL_RCCEx_PeriphCLKConfig(&PeriphClkInitStruct) != HAL_OK)
  {
    Error_Handler();
  }
}

void Error_Handler(void)
{
  __disable_irq();
  while (1)
  {
  }
}
